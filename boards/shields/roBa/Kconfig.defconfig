## boards/shields/roBa/Kconfig.defconfig
```kconfig
if SHIELD_robaih_R

config ZMK_KEYBOARD_NAME
    default "robaih_R"

config ZMK_SPLIT
    default y

config ZMK_SPLIT_ROLE_CENTRAL
    default y

endif

if SHIELD_robaih_L

config ZMK_KEYBOARD_NAME
    default "robaih_L"

config ZMK_SPLIT
    default y

endif
```

## boards/shields/roBa/Kconfig.shield
```kconfig
config SHIELD_robaih_R
    def_bool $(shields_list_contains,robaih_R)

config SHIELD_robaih_L
    def_bool $(shields_list_contains,robaih_L)
```
